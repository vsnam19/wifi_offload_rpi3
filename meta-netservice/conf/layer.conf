## meta-netservice/conf/layer.conf
```bitbake
# meta-netservice layer configuration
# Yocto Scarthgap 5.0 compatible

BBPATH .= ":${LAYERDIR}"
BBFILES += "${LAYERDIR}/recipes-*/*/*.bb \
             ${LAYERDIR}/recipes-*/*/*.bbappend"

BBFILE_COLLECTIONS += "netservice"
BBFILE_PATTERN_netservice = "^${LAYERDIR}/"
BBFILE_PRIORITY_netservice = "10"

LAYERVERSION_netservice = "1"
LAYERSERIES_COMPAT_netservice = "scarthgap"

LAYERDEPENDS_netservice = "core openembedded-layer networking-layer"
```
